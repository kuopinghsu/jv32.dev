// ============================================================================
// File: sram_1rw.sv  (syn/lib — synthesis black-box wrapper)
// Project: JV32 RISC-V Processor
//
// Synthesis wrapper: maps the generic sram_1rw interface to OpenRAM hard
// macros generated by 'make gen-mem' for Nangate FreePDK45.
//
// jv32_top instantiates sram_1rw with exactly one parameter set per byte lane:
//
//   DEPTH = IRAM_SIZE/4 = 32768  (128 KB TCM, 4 byte lanes)
//   WIDTH = 8                    (byte-lane bank)
//
// Each 32768-deep byte lane is implemented as 4 × sram_1rw_8192x8 (32 KB each):
//
//   addr[14:13] — selects one of 4 sub-banks
//   addr[12:0]  — word address within the selected sub-bank
//
// Total macro instances:
//   4 byte lanes × 4 sub-banks × IRAM = 16 macros
//   4 byte lanes × 4 sub-banks × DRAM = 16 macros
//                                        ─────────
//                                        32 sram_1rw_8192x8 instances
//
// OpenRAM single-port (num_rw_ports=1) pin convention:
//   clk0  – rising-edge clock
//   csb0  – chip-select bar (active-low);  inactive banks get csb0=1
//   web0  – write-enable bar (active-low)
//   addr0 – word address (13 bits for 8192-word macro)
//   din0  – write data (8 bits)
//   dout0 – read data (registered, valid 1 cycle after read access)
//
// If TCM sizes change, re-run:
//   make gen-mem [IRAM_SIZE=N] [DRAM_SIZE=N]
// and adjust the generate-block below.
// ============================================================================

// This file replaces rtl/memories/sram_1rw.sv in the synthesis RTL file list.

module sram_1rw #(
    parameter int DEPTH = 256,
    parameter int WIDTH = 32
) (
    input  logic                     clk,
    input  logic                     ce,    // chip enable (active-high)
    input  logic                     we,    // write enable (active-high)
    input  logic [$clog2(DEPTH)-1:0] addr,
    input  logic [WIDTH-1:0]         wdata,
    output logic [WIDTH-1:0]         rdata
);

generate

    // -------------------------------------------------------------------------
    // TCM byte-lane SRAM: 32768 words × 8 bits
    // Implemented as 4 × sram_1rw_8192x8 sub-banks (32 KB each).
    // Matches jv32_top with IRAM_SIZE = DRAM_SIZE = 128 KB:
    //   DEPTH = 128*1024/4 = 32768,  WIDTH = 8
    // -------------------------------------------------------------------------
    if (DEPTH == 32768 && WIDTH == 8) begin : g_tcm_byte_sram

        // addr is 15 bits [14:0].  Top 2 bits select the sub-bank; lower 13
        // bits are passed to the selected macro.
        logic [1:0]  bank_sel;
        logic [12:0] sub_addr;
        logic [7:0]  dout [0:3]; // registered outputs from each sub-bank

        assign bank_sel = addr[14:13];
        assign sub_addr = addr[12:0];

        genvar i;
        for (i = 0; i < 4; i++) begin : g_bank
            sram_1rw_8192x8 u_sub (
                .clk0 (clk),
                // Only the selected bank is chip-selected; unselected banks
                // are idle (csb0=1) so they don't consume read power.
                .csb0 (~(ce & (bank_sel == 2'(i)))),
                .web0 (~we),
                .addr0(sub_addr),
                .din0 (wdata),
                .dout0(dout[i])
            );
        end

        // Mux registered output from the bank that was selected on the
        // previous cycle.  Bank select must be re-registered to align with
        // the one-cycle SRAM read latency.
        logic [1:0] bank_sel_q;
        always_ff @(posedge clk)
            bank_sel_q <= bank_sel;

        assign rdata = dout[bank_sel_q];

    // -------------------------------------------------------------------------
    // Fallback: behavioural register-array model.
    // Caught at synthesis to flag missing OpenRAM macros for new SRAM sizes.
    // -------------------------------------------------------------------------
    end else begin : g_fallback

        initial $error("sram_1rw: no OpenRAM macro for DEPTH=%0d WIDTH=%0d – run 'make gen-mem'",
                       DEPTH, WIDTH);

        logic [WIDTH-1:0] mem [0:DEPTH-1];

        always_ff @(posedge clk) begin
            if (ce) begin
                if (we) mem[addr] <= wdata;
                else    rdata     <= mem[addr];
            end
        end

    end

endgenerate

endmodule


    end

endgenerate

endmodule
