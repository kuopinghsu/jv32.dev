// ============================================================================
// File: sram_1rw.sv  (syn/lib     synthesis black-box wrapper)
// Project: JV32 RISC-V Processor
//
// Synthesis wrapper: maps the generic sram_1rw interface to OpenRAM hard
// macros generated by 'make gen-mem' for Nangate FreePDK45.
//
// jv32_top instantiates one 32-bit-wide SRAM per TCM:
//
//   DEPTH = IRAM_SIZE/4 = 32768  (128 KB / 4 bytes-per-word)
//   WIDTH = 32
//   wbe   = 4-bit byte write enables
//
// Each 32768  32 TCM is implemented as 16    sram_1rw_2048x32 sub-banks:
//
//   addr[14:11]     selects one of 16 sub-banks (4 bits)
//   addr[10:0]      word address within the selected sub-bank (11-bit, 2048 rows)
//
// Macro choice rationale:
//       words_per_row = 1      no column-mux DFF routing (avoids cyclic-VCG bug)
//       num_rows = 2048        11-bit row decoder, well within OpenRAM limits
//       write_size = 8         wmask0[3:0] gives per-byte write granularity
//
// Total instances:
//   16 sub-banks    IRAM = 16 macros
//   16 sub-banks    DRAM = 16 macros       32 sram_1rw_2048x32 total
//
// OpenRAM single-port (num_rw_ports=1, write_size=8) pin convention:
//   clk0          rising-edge clock
//   csb0          chip-select bar (active-low); idle banks driven csb0=1
//   web0          write-enable bar (active-low)
//   wmask0[3:0]     byte write mask (active-high, bit i enables byte i)
//   addr0[10:0]     word address (11 bits for 2048-word macro)
//   din0[31:0]      write data
//   dout0[31:0]     read data (registered, valid 1 cycle after read access)
//
// If TCM sizes change, re-run:
//   make gen-mem [IRAM_SIZE=N] [DRAM_SIZE=N]
// and adjust the generate-block below.
// ============================================================================

// This file replaces rtl/memories/sram_1rw.sv in the synthesis RTL file list.

module sram_1rw #(
    parameter int DEPTH = 2048,
    parameter int WIDTH = 32
) (
    input  logic                       clk,
    input  logic                       ce,     // chip enable (active-high)
    input  logic                       we,     // write enable (any byte active)
    input  logic [(WIDTH/8)-1:0]       wbe,    // byte write enables (active-high)
    input  logic [$clog2(DEPTH)-1:0]   addr,
    input  logic [WIDTH-1:0]           wdata,
    output logic [WIDTH-1:0]           rdata
);

generate

    // -------------------------------------------------------------------------
    // TCM 32-bit SRAM: 32768 words    32 bits  (128 KB per TCM)
    // Decomposed into 16    sram_1rw_2048x32 sub-banks.
    // Matches jv32_top with IRAM_SIZE = DRAM_SIZE = 128 KB:
    //   DEPTH = 128*1024/4 = 32768,  WIDTH = 32
    // -------------------------------------------------------------------------
    if (DEPTH == 32768 && WIDTH == 32) begin : g_tcm_sram

        // addr is 15 bits [14:0].
        // Top 4 bits select one of 16 sub-banks; lower 11 bits address within it.
        localparam int N_BANKS    = 16;
        localparam int BANK_ABITS = 11;  // log2(2048)

        logic [3:0]  bank_sel;
        logic [10:0] sub_addr;
        logic [31:0] dout [0:N_BANKS-1];

        assign bank_sel = addr[14:11];
        assign sub_addr = addr[10:0];

        genvar i;
        for (i = 0; i < N_BANKS; i++) begin : g_bank
            sram_1rw_2048x32 u_sub (
                .clk0   (clk),
                // Deselect inactive banks to save power and avoid write conflicts
                .csb0   (~(ce & (bank_sel == 4'(i)))),
                .web0   (~we),
                .wmask0 (wbe),
                .addr0  (sub_addr),
                .din0   (wdata),
                .dout0  (dout[i])
            );
        end

        // Re-register bank_sel to match the 1-cycle SRAM read latency
        logic [3:0] bank_sel_q;
        always_ff @(posedge clk)
            bank_sel_q <= bank_sel;

        assign rdata = dout[bank_sel_q];

    // -------------------------------------------------------------------------
    // Fallback: behavioural model.
    // Synthesis will error here if a new SRAM size appears without a matching
    // OpenRAM macro     run 'make gen-mem' and add a new generate branch above.
    // -------------------------------------------------------------------------
    end else begin : g_fallback

        initial $error("sram_1rw: no OpenRAM macro for DEPTH=%0d WIDTH=%0d     run 'make gen-mem'",
                       DEPTH, WIDTH);

        logic [WIDTH-1:0] mem [0:DEPTH-1];

        always_ff @(posedge clk) begin
            if (ce) begin
                if (we) begin
                    for (int _b = 0; _b < WIDTH/8; _b++)
                        if (wbe[_b]) mem[addr][_b*8 +: 8] <= wdata[_b*8 +: 8];
                end else begin
                    rdata <= mem[addr];
                end
            end
        end

    end

endgenerate

endmodule

// ---------------------------------------------------------------------------
// OpenRAM hard macro black-box declaration.
// OpenLane's Verilator/Surelog lint passes need an RTL module definition for
// the instantiated macro name, but the implementation is provided by the
// OpenRAM LEF/GDS/Liberty views during physical design.
// ---------------------------------------------------------------------------
(* blackbox *)
module sram_1rw_2048x32 (
    input  logic        clk0,
    input  logic        csb0,
    input  logic        web0,
    input  logic [3:0]  wmask0,
    input  logic [10:0] addr0,
    input  logic [31:0] din0,
    output logic [31:0] dout0
);
endmodule
