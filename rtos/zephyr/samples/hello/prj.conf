## CMakeLists.txt
```
# Copyright (c) 2026 jv32 Project
# SPDX-License-Identifier: Apache-2.0

cmake_minimum_required(VERSION 3.20.0)

# Find Zephyr package
find_package(Zephyr REQUIRED HINTS $ENV{ZEPHYR_BASE})

project(hello)

# Application source files
target_sources(app PRIVATE src/main.c)
```

## prj.conf
```kconfig
# Copyright (c) 2026 jv32 Project
# SPDX-License-Identifier: Apache-2.0

# Enable console with magic address driver (fast simulation)
CONFIG_CONSOLE=n
CONFIG_CONSOLE_JV32=y
CONFIG_PRINTK=y

# Explicitly disable UART console
CONFIG_UART_CONSOLE=n
CONFIG_SERIAL=n

# Minimal C library
CONFIG_MINIMAL_LIBC=y

# Stack sizes
CONFIG_MAIN_STACK_SIZE=2048
CONFIG_IDLE_STACK_SIZE=512

# Disable system clock/timer for ultra-minimal build
CONFIG_SYS_CLOCK_EXISTS=n

# Optimize for size
CONFIG_SIZE_OPTIMIZATIONS=y
```

## src/main.c
```c
/*
 * Copyright (c) 2026 jv32 Project
 * SPDX-License-Identifier: Apache-2.0
 *
 * Simple Hello World application for jv32 board
 * Uses magic address console driver for fast simulation output
 */

#include <zephyr/kernel.h>
#include <zephyr/sys/printk.h>
#include <zephyr/version.h>
#include "jv_platform.h"

void main(void)
{
    printk("*** Booting Zephyr OS build %s ***\n", KERNEL_VERSION_STRING);
    printk("Hello World! jv32 RISC-V Board\n");
    printk("Test completed successfully!\n");
    jv_exit(0);
}
```
