## rtos/zephyr/boards/riscv/jv32/Kconfig.board
```kconfig
# Copyright (c) 2026 jv32 Project
# SPDX-License-Identifier: Apache-2.0

config BOARD_JV32
    bool "jv32 RISC-V Development Board"
    depends on SOC_RISCV_JV32
    help
      Enable support for the jv32 RISC-V development board.
      This board features:
      - RV32IM processor core
      - 2MB RAM
      - UART console
      - CLINT timer/interrupts
```

## rtos/zephyr/boards/riscv/jv32/Kconfig.defconfig
```kconfig
# Copyright (c) 2026 jv32 Project
# SPDX-License-Identifier: Apache-2.0

if BOARD_JV32

config BOARD
    default "jv32"

# Disable UART console by default - use magic address console instead
config UART_CONSOLE
    default n

config SERIAL
    default n
# Timer configuration
config RISCV_MACHINE_TIMER
    default y if SYS_CLOCK_EXISTS

config SYS_CLOCK_HW_CYCLES_PER_SEC
    default 50000000

config SYS_CLOCK_TICKS_PER_SEC
    default 100
endif # BOARD_JV32
```

## rtos/zephyr/boards/riscv/jv32/board.yml
```yaml
board:
  name: jv32
  full_name: JV32 RISC-V SoC
  vendor: jv32
  socs:
    - name: jv32
```

## rtos/zephyr/boards/riscv/jv32/jv32_defconfig
```kconfig
# Copyright (c) 2026 jv32 Project
# SPDX-License-Identifier: Apache-2.0

# SoC configuration
CONFIG_SOC_RISCV_JV32=y

# Serial and Console configuration
CONFIG_SERIAL=y
CONFIG_CONSOLE=y
CONFIG_CONSOLE_JV32=y
CONFIG_PRINTK=y

# Minimal footprint
CONFIG_MINIMAL_LIBC=y
CONFIG_SIZE_OPTIMIZATIONS=y

# Stack sizes
CONFIG_MAIN_STACK_SIZE=2048
CONFIG_IDLE_STACK_SIZE=512
CONFIG_ISR_STACK_SIZE=2048
```

## rtos/zephyr/drivers/Kconfig
```kconfig
# Copyright (c) 2026 jv32 Project
# SPDX-License-Identifier: Apache-2.0

rsource "console/Kconfig*"
rsource "serial/Kconfig*"
```

## rtos/zephyr/drivers/console/Kconfig.jv32
```kconfig
# Copyright (c) 2026 jv32 Project
# SPDX-License-Identifier: Apache-2.0

config CONSOLE_JV32
    bool "jv32 magic address console driver"
    help
      Enable console driver that writes to magic address 0x40000000.
      This is useful for simulation/testbench where characters written
      to this address appear in the console output.

      This driver provides faster simulation performance compared to
      the full UART driver, as it bypasses hardware FIFO and baud rate
      timing simulation.

if CONSOLE_JV32

config CONSOLE_INIT_PRIORITY
    default 40

endif # CONSOLE_JV32
```

## rtos/zephyr/drivers/serial/Kconfig.jv32
```kconfig
# Copyright (c) 2026 jv32 Project
# SPDX-License-Identifier: Apache-2.0

config UART_JV32
    bool "jv32 UART driver"
    default y
    depends on DT_HAS_JV32_UART_ENABLED
    select SERIAL
    select SERIAL_HAS_DRIVER
    select SERIAL_SUPPORT_INTERRUPT
    help
      Enable driver for jv32 custom UART peripheral.
      This UART has TX capability with a 16-entry FIFO.

if UART_JV32

config UART_JV32_PORT_0
    bool "Enable UART Port 0"
    default y
    help
      Enable UART port 0 (the main console UART).

endif # UART_JV32
```

## rtos/zephyr/samples/stress/testcase.yaml
```yaml
# ===================================================================
# testcase.yaml  --  twister test runner metadata
# ===================================================================

tests:
  zephyr_stress.all:
    tags: kernel stress context_switch
    platform_allow:
      - native_sim
    timeout: 120
    harness: ztest
    harness_config:
      type: one_line
      regex:
        - "PASS"
```

## rtos/zephyr/soc/riscv/jv32/Kconfig.soc
```kconfig
# Copyright (c) 2026 jv32 Project
# SPDX-License-Identifier: Apache-2.0

config SOC_RISCV_JV32
    bool "RISC-V jv32 SoC"
    select RISCV
    select RISCV_PRIVILEGED
    select RISCV_ISA_RV32I
    select RISCV_ISA_EXT_M
    select RISCV_ISA_EXT_A
    select RISCV_ISA_EXT_C
    select RISCV_ISA_EXT_ZICSR
    select RISCV_ISA_EXT_ZIFENCEI
    select RISCV_HAS_CPU_IDLE
    help
      Enable support for the custom RISC-V RV32IMAC jv32 SoC.
      This is a 3-stage single-issue pipeline with:
      - RV32I base integer instruction set
      - M extension (multiply/divide)
      - A extension (atomics/AMO)
      - C extension (compressed instructions)
      - 256KB RAM (128KB IRAM @ 0x80000000, 128KB DRAM @ 0xC0000000)
      - Custom UART peripheral (0x20010000)
      - CLIC timer/interrupt controller (0x02000000)

config SOC
    default "jv32" if SOC_RISCV_JV32

config SYS_CLOCK_HW_CYCLES_PER_SEC
    default 50000000 if SOC_RISCV_JV32

config RISCV_SOC_INTERRUPT_INIT
    default y if SOC_RISCV_JV32

config NUM_IRQS
    default 32 if SOC_RISCV_JV32

config RISCV_HAS_CPU_IDLE
    bool
    default y if SOC_RISCV_JV32

# Enable RISCV_MACHINE_TIMER for sys_clock
config RISCV_MACHINE_TIMER
    bool
    default y if SOC_RISCV_JV32
```
